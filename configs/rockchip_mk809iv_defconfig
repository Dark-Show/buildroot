## configs/rockchip_mk809iv_defconfig
```kconfig
# Architecture
BR2_arm=y
BR2_cortex_a7=y
BR2_ARM_FPU_NEON_VFPV4=y

# Linux headers same as kernel, a 5.9 series
BR2_PACKAGE_HOST_LINUX_HEADERS_CUSTOM_5_9=y

# Bootloader https://github.com/rockchip-linux/u-boot/archive/505eebf24e153630f5a3e0ec232ffda67bf48e9e.tar.gz
BR2_TARGET_UBOOT=y
BR2_TARGET_UBOOT_BUILD_SYSTEM_KCONFIG=y
BR2_TARGET_UBOOT_CUSTOM_TARBALL=y
BR2_TARGET_UBOOT_CUSTOM_TARBALL_LOCATION="https://github.com/rockchip-linux/u-boot/archive/505eebf24e153630f5a3e0ec232ffda67bf48e9e.tar.gz"
BR2_TARGET_UBOOT_PATCH="board/rockchip/mk809iv/patches-uboot/"
BR2_TARGET_UBOOT_BOARD_DEFCONFIG="rk322x-linux-miniloader-mkv809vii"
BR2_TARGET_UBOOT_NEEDS_DTC=y
BR2_TARGET_UBOOT_NEEDS_PYTHON3=y
BR2_TARGET_UBOOT_NEEDS_PYLIBFDT=y
BR2_TARGET_UBOOT_NEEDS_OPENSSL=y
BR2_TARGET_UBOOT_FORMAT_DTB_IMG=y
BR2_TARGET_UBOOT_FORMAT_DTB_BIN=y
BR2_TARGET_UBOOT_SPL=y
BR2_TARGET_UBOOT_SPL_NAME="idbloader.img"

# Kernel https://www.kernel.org/pub/linux/kernel/v5.x/linux-5.9.6.tar.xz
BR2_LINUX_KERNEL=y
BR2_LINUX_KERNEL_CUSTOM_VERSION=y
BR2_LINUX_KERNEL_CUSTOM_VERSION_VALUE="5.9.6"
BR2_LINUX_KERNEL_PATCH="board/rockchip/mk809iv/patches-kernel/"
BR2_LINUX_KERNEL_USE_CUSTOM_CONFIG=y
BR2_LINUX_KERNEL_CUSTOM_CONFIG_FILE="board/rockchip/mk809iv/rk322x.conf"
BR2_LINUX_KERNEL_DTS_SUPPORT=y
BR2_LINUX_KERNEL_INTREE_DTS_NAME="rk3228a-box"
BR2_LINUX_KERNEL_NEEDS_HOST_OPENSSL=y

# Filesystem
BR2_TARGET_GENERIC_HOSTNAME="mk809iv-ds"
BR2_TARGET_GENERIC_ISSUE="Welcome to MK809IV"
BR2_TARGET_ROOTFS_EXT2=y
BR2_TARGET_ROOTFS_EXT2_4=y
BR2_ROOTFS_POST_BUILD_SCRIPT="board/rockchip/mk809iv/post-build.sh"
BR2_ROOTFS_POST_IMAGE_SCRIPT="support/scripts/genimage.sh"
BR2_ROOTFS_POST_SCRIPT_ARGS="-c board/rockchip/mk809iv/genimage.cfg"

BR2_PACKAGE_HOST_DOSFSTOOLS=y
BR2_PACKAGE_HOST_GENIMAGE=y
BR2_PACKAGE_HOST_MTOOLS=y
BR2_PACKAGE_HOST_RKBIN=y
BR2_PACKAGE_HOST_UBOOT_TOOLS=y
```

## package/rkbin/Config.in.host
```kconfig
config BR2_PACKAGE_HOST_RKBIN
	bool "host rkbin"
	help
	  Tools for creating bootable rockchip images with related firmware.

	  https://github.com/knaerzche/rkbin
```
